## config/boards/shields/rev1350/Kconfig.defconfig
```kconfig
# Copyright (c) 2020 The ZMK Contributors
# SPDX-License-Identifier: MIT

if SHIELD_REV1350

config ZMK_KEYBOARD_NAME
    default "rev1350"

config ZMK_BLE_PASSKEY_ENTRY
		default "y"

#config ZMK_BLE_EXPERIMENTAL_FEATURES
#		default "y"

endif
```
